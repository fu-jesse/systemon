## CMakeLists.txt
```
# Copyright (c) 2026 Nordic Semiconductor ASA
#
# SPDX-License-Identifier: LicenseRef-Nordic-5-Clause

cmake_minimum_required(VERSION 3.20.0)

find_package(Zephyr REQUIRED HINTS $ENV{ZEPHYR_BASE})

project(systemon)

target_sources(app PRIVATE src/main.c)
```

## Kconfig
```
# Copyright (c) 2026 Nordic Semiconductor ASA
#
# SPDX-License-Identifier: LicenseRef-Nordic-5-Clause

mainmenu "Systemon sample"

config APP_RAM_POWER_DOWN_UNUSED
	bool "Power down unused RAM sections in System ON IDLE"
	default y
	depends on SOC_SERIES_NRF54L && !TRUSTED_EXECUTION_NONSECURE
	imply RAM_POWER_DOWN_LIBRARY
	help
	  Power down the RAM sections (32 KB each) that lie completely above the
	  RAM used by the image. The content of a powered down section is not
	  retained. Disable it to keep all RAM powered.
	  The RAM power down library (power_down_unused_ram()) is used when
	  RAM_POWER_DOWN_LIBRARY is enabled (implied by default); set it to n to
	  power down the sections directly through nrf_memconf instead.

source "Kconfig.zephyr"
```

## sample.yaml
```
sample:
  description: Evaluate system on idle current for nRF54 family for lfxo and lfrc two typical hw config
  name: systemon
common:
  sysbuild: true
  build_only: true
  tags: systemon
  platform_allow:
    - nrf54l15dk/nrf54l15/cpuapp
    - nrf54lm20dk/nrf54lm20a/cpuapp
    - nrf54lm20dk/nrf54lm20b/cpuapp
    - nrf54ls05dk/nrf54ls05a/cpuapp
    - nrf54ls05dk/nrf54ls05b/cpuapp
tests:
  # name: sample.systemon.<log|nolog>.<ramtrim|ramall>.<lfxo|lfrc>
  #   log     : prj.conf, log on uart20          nolog : FILE_SUFFIX=release, no log, uart20 disabled
  #   ramtrim : unused RAM powered down          ramall: ram_all.conf, all RAM powered
  #   lfxo    : LFXO low-frequency clock         lfrc  : lfrc.conf, LFRC with 4 s calibration
  sample.systemon.log.ramtrim.lfxo:
    extra_args: ""
  sample.systemon.log.ramtrim.lfrc:
    extra_args: EXTRA_CONF_FILE="lfrc.conf"
  sample.systemon.log.ramall.lfxo:
    extra_args: EXTRA_CONF_FILE="ram_all.conf"
  sample.systemon.log.ramall.lfrc:
    extra_args: EXTRA_CONF_FILE="ram_all.conf;lfrc.conf"
  sample.systemon.nolog.ramtrim.lfxo:
    extra_args: FILE_SUFFIX=release
  sample.systemon.nolog.ramtrim.lfrc:
    extra_args: FILE_SUFFIX=release EXTRA_CONF_FILE="lfrc.conf"
  sample.systemon.nolog.ramall.lfxo:
    extra_args: FILE_SUFFIX=release EXTRA_CONF_FILE="ram_all.conf"
  sample.systemon.nolog.ramall.lfrc:
    extra_args: FILE_SUFFIX=release EXTRA_CONF_FILE="ram_all.conf;lfrc.conf"
```

## prj.conf
```kconfig
# Copyright (c) 2026 Nordic Semiconductor ASA
#
# SPDX-License-Identifier: LicenseRef-Nordic-5-Clause

CONFIG_LOG=y
CONFIG_SERIAL=y
CONFIG_UART_CONSOLE=y
CONFIG_LOG_BACKEND_UART=y
CONFIG_PM_DEVICE=y
CONFIG_PM_DEVICE_RUNTIME=y

# Deprecated symbol, replaced by SOC_SERIES_NRF54L
CONFIG_NRF_PLATFORM_LUMOS=n
CONFIG_RAM_POWER_DOWN_LIBRARY=n
```

## lfrc.conf
```kconfig
# Copyright (c) 2026 Nordic Semiconductor ASA
#
# SPDX-License-Identifier: LicenseRef-Nordic-5-Clause

# Use the internal LFRC as the 32.768 kHz low-frequency clock source (default: LFXO)
CONFIG_CLOCK_CONTROL_NRF_K32SRC_RC=y

# Calibration opportunity every 4 s (skipped when temperature change is small)
CONFIG_CLOCK_CONTROL_NRF_CALIBRATION_PERIOD=4000
```

## prj_release.conf
```kconfig
# Copyright (c) 2026 Nordic Semiconductor ASA
#
# SPDX-License-Identifier: LicenseRef-Nordic-5-Clause

CONFIG_LOG=n
CONFIG_SERIAL=n
CONFIG_PM_DEVICE=y
CONFIG_PM_DEVICE_RUNTIME=y

# Board defaults select the UART console; there is no serial driver in release
CONFIG_UART_CONSOLE=n

# Deprecated symbol, replaced by SOC_SERIES_NRF54L
CONFIG_NRF_PLATFORM_LUMOS=n
```

## ram_all.conf
```kconfig
# Copyright (c) 2026 Nordic Semiconductor ASA
#
# SPDX-License-Identifier: LicenseRef-Nordic-5-Clause

# Keep all RAM powered (default: unused RAM sections are powered down)
CONFIG_APP_RAM_POWER_DOWN_UNUSED=n
```

## boards/dk_common.overlay
```dts
/*
 * Copyright (c) 2026 Nordic Semiconductor ASA
 *
 * SPDX-License-Identifier: LicenseRef-Nordic-5-Clause
 */

/* Common to all DKs: remove all LEDs, buttons and PWM, suspend uart20 at boot */

/ {
	/delete-node/ leds;
	/delete-node/ pwmleds;
	/delete-node/ buttons;

	aliases {
		/delete-property/ led0;
		/delete-property/ led1;
		/delete-property/ led2;
		/delete-property/ led3;
		/delete-property/ pwm-led0;
		/delete-property/ sw0;
		/delete-property/ sw1;
		/delete-property/ sw2;
		/delete-property/ sw3;
		/delete-property/ mcuboot-button0;
		/delete-property/ mcuboot-led0;
	};
};

/* PWM is not used (pwmleds removed above) */
&pwm20 {
	status = "disabled";
};

/* Suspend uart20 at boot; the log backend resumes it only while printing */
&uart20 {
	zephyr,pm-device-runtime-auto;
};
```

## src/main.c
```c
/**
******************************************************************************
* Copyright (c) 2026 Nordic Semiconductor ASA
* Filename : main.c
* Date(DD-MM-YYYY)    Modification    Name
* ----------------    ------------    ----
* 14-10-2026          Created         JF
*******************************************************************************
*/

/* Includes ------------------------------------------------------------------*/
#include <zephyr/kernel.h>
#include <zephyr/logging/log.h>
#include <zephyr/linker/linker-defs.h>
#if defined(CONFIG_APP_RAM_POWER_DOWN_UNUSED)
#if defined(CONFIG_RAM_POWER_DOWN_LIBRARY)
#include <ram_pwrdn.h>
#else
#include <hal/nrf_memconf.h>
#endif
#endif

/* Macro----------------------------------------------------------------------*/
#define LOG_MODULE_NAME main
LOG_MODULE_REGISTER(LOG_MODULE_NAME);

#define RAM_BASE            DT_REG_ADDR(DT_CHOSEN(zephyr_sram))
#define RAM_SIZE            DT_REG_SIZE(DT_CHOSEN(zephyr_sram))
#define RAM_SECTION_SIZE    KB(32)

/* Private typedef -----------------------------------------------------------*/

/* Private function prototypes------------------------------------------------*/
static void ram_report_and_trim(void);

/* Global variables ----------------------------------------------------------*/

/* Private variables ---------------------------------------------------------*/

/* Macro ---------------------------------------------------------------------*/

/* Exported functions --------------------------------------------------------*/
int main(void)
{
    LOG_PRINTK("****************************************\n");
    LOG_PRINTK("system on sample started\n");
    LOG_PRINTK("****************************************\n");

    ram_report_and_trim();

    return 0;
}

/* Override functions -------------------------------------------------------*/

/* Private Functions ---------------------------------------------------------*/

/**
 * @brief Report the RAM used by the image and power down the unused RAM sections.
 *
 * The used RAM is everything the linker placed in RAM (data, bss, noinit,
 * stacks and static heaps). Only sections that lie completely above it and
 * completely inside the application SRAM are powered down (System ON IDLE),
 * using the RAM power down library (power_down_unused_ram) when
 * CONFIG_RAM_POWER_DOWN_LIBRARY is enabled, otherwise directly through nrf_memconf.
 *
 * The trim runs once, at the start of main(). It assumes nothing is placed in
 * RAM above _image_ram_end (e.g. no extra memory-region or retained RAM there);
 * anything above it loses its content.
 */
static void ram_report_and_trim(void)
{
    const uintptr_t used_start = (uintptr_t)_image_ram_start;
    const uintptr_t used_end = (uintptr_t)_image_ram_end;
    const uint32_t total_sections = DIV_ROUND_UP(RAM_SIZE, RAM_SECTION_SIZE);
    const uint32_t first_unused = DIV_ROUND_UP(used_end - RAM_BASE, RAM_SECTION_SIZE);
    uint32_t powered_down = 0;

    LOG_INF("RAM total %u KB (%u x %u KB sections), used %u B (%u KB), free %u KB",
            (uint32_t)(RAM_SIZE / 1024U), total_sections, (uint32_t)(RAM_SECTION_SIZE / 1024U),
            (uint32_t)(used_end - used_start), (uint32_t)DIV_ROUND_UP(used_end - used_start, 1024U),
            (uint32_t)((RAM_BASE + RAM_SIZE - used_end) / 1024U));

#if defined(CONFIG_APP_RAM_POWER_DOWN_UNUSED)
    /* Rounded down on purpose: a trailing section that is only partly inside the
     * application SRAM (nRF54LM20: 511 KB) is not owned by the app and stays powered.
     */
    const uint32_t last_owned = RAM_SIZE / RAM_SECTION_SIZE;

#if defined(CONFIG_RAM_POWER_DOWN_LIBRARY)
    if (first_unused < last_owned)
    {
        powered_down = last_owned - first_unused;
    }

    power_down_unused_ram();
#else
    for (uint32_t i = first_unused; i < last_owned && i < 32U; i++)
    {
        nrf_memconf_ramblock_control_enable_set(NRF_MEMCONF, 0, i, false);
        powered_down++;
    }
#endif
#endif

    LOG_INF("RAM sections powered: %u/%u (sections %u..%u powered down: %u)",
            total_sections - powered_down, total_sections, first_unused,
            (powered_down > 0U) ? (first_unused + powered_down - 1U) : first_unused,
            powered_down);
}

/* Macro ---------------------------------------------------------------------*/
```
